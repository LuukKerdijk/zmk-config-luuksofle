/ {
    chosen {
        zmk,split-role = "central";
    };

    usb_device: usb_device {
        compatible = "zmk,usb-device";
        manufacturer = "Sofle";
        product = "Sofle Right";
        serial-number = "0002";  /* optional */
    };
};
