## config/boards/shields/soflergb/Kconfig.defconfig
```kconfig
if SHIELD_SOFLERGB_RIGHT

# Name must be less than 16 characters long!
config ZMK_KEYBOARD_NAME
    default "SofleRGB"

config ZMK_SPLIT_ROLE_CENTRAL
    default y

endif

if SHIELD_SOFLERGB_LEFT || SHIELD_SOFLERGB_RIGHT

config ZMK_SPLIT
    default y

endif
```

## config/boards/shields/soflergb/Kconfig.shield
```kconfig
# No whitespace after the comma or in your part name!
config SHIELD_SOFLERGB_LEFT
    def_bool $(shields_list_contains,soflergb_left)

# No whitespace after the comma or in your part name!
config SHIELD_SOFLERGB_RIGHT
    def_bool $(shields_list_contains,soflergb_right)
```
